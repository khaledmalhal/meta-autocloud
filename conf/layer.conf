## conf/layer.conf
```bitbake
# Enable systemd
INIT_MANAGER = "systemd"

DISTRO_FEATURES:append = " virtualization"

LAYERSERIES_COMPAT_openembedded-core = "scarthgap"
LAYERSERIES_COMPAT_openembedded-layer = "scarthgap"
LAYERSERIES_COMPAT_meta-python = "scarthgap"
# LAYERSERIES_COMPAT_meta-arm = "scarthgap"
LAYERSERIES_COMPAT_networking-layer = "scarthgap"
LAYERSERIES_COMPAT_filesystems-layer = "scarthgap"
LAYERSERIES_COMPAT_virtualization-layer = "scarthgap"

IMAGE_INSTALL:append = " \
    alsa-utils \
    bluez5 \
    e2fsprogs \
    evtest \
    canutils \
    docker-compose \
    gptfdisk \
    i2c-tools \
    iperf3 \
    iw \
    kernel-modules \
    linux-firmware \
    minicom \
    packagegroup-core-full-cmdline \
    parted \
    pciutils \
    ppp \
    usbutils \
    wpa-supplicant \
    libgpiod \
    libgpiod-dev \
    libgpiod-tools \
"
```
